## linux-ck-pax/kconfig.patch
```kconfig
diff -aur ./linux-3.15/arch/x86/Kconfig.cpu ./linux-3.15-new/arch/x86/Kconfig.cpu
--- ./arch/x86/Kconfig.cpu	2014-06-08 19:19:54.000000000 +0100
+++ ./arch/x86/Kconfig.cpu	2014-07-03 12:50:03.432588622 +0100
@@ -359,7 +359,7 @@
 
 config X86_TSC
 	def_bool y
-	depends on (MWINCHIP3D || MCRUSOE || MEFFICEON || MCYRIXIII || MK7 || MK6 || MPENTIUM4 || MPENTIUMM || MPENTIUMIII || MPENTIUMII || M686 || M586MMX || M586TSC || MK8 || MVIAC3_2 || MVIAC7 || MGEODEGX1 || MGEODE_LX || MCORE2 || MATOM) || X86_64
+	depends on ((MWINCHIP3D || MCRUSOE || MEFFICEON || MCYRIXIII || MK7 || MK6 || MPENTIUM4 || MPENTIUMM || MPENTIUMIII || MPENTIUMII || M686 || M586MMX || M586TSC || MK8 || MVIAC3_2 || MVIAC7 || MGEODEGX1 || MGEODE_LX || MCORE2 || MATOM) && !X86_NUMAQ) || X86_64
 
 config X86_CMPXCHG64
 	def_bool y
```
